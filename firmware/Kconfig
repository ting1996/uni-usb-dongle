## firmware/defconfig
```kconfig
CONFIG_FREERTOS=y
CONFIG_LITTLEFS=y
CONFIG_BFLB_MTD=y
CONFIG_PARTITION=y
CONFIG_BFLB_LOG=n
CONFIG_FOTA=y
CONFIG_FOTA_NO_SHELL=y
CONFIG_CHERRYUSB=y
CONFIG_CHERRYUSB_OSAL=freertos
CONFIG_CHERRYUSB_DEVICE=y
CONFIG_CHERRYUSB_DEVICE_CDC_ACM=y
CONFIG_CHERRYUSB_DEVICE_HID=y
CONFIG_CHERRYUSB_DEVICE_AUDIO=y
CONFIG_BLUETOOTH=y
CONFIG_RF=y
CONFIG_BTBLECONTROLLER_LIB=ble1m2s1bredr1
CONFIG_BT_BREDR=y
CONFIG_BT_A2DP=n
CONFIG_BT_A2DP_SOURCE=n
CONFIG_BT_A2DP_SINK=n
CONFIG_BT_AVRCP=y
CONFIG_BT_HFP=n
CONFIG_BT_STACK_CLI=n
CONFIG_BT_SETTINGS=y
CONFIG_EM_SIZE=32
```
